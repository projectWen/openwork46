## config/boards/shields/kafka/Kconfig.defconfig
```kconfig
# Copyright (c) 2022 Duccio Breschi
# SPDX-License-Identifier: MIT

if SHIELD_OPENWORK_LEFT

config ZMK_KEYBOARD_NAME
    default "OPENWORK"

config ZMK_SPLIT_ROLE_CENTRAL
    default y

endif

if SHIELD_OPENWORK_LEFT || SHIELD_OPENWORK_RIGHT

config ZMK_SPLIT
    default y

endif
```

## config/boards/shields/kafka/Kconfig.shield
```kconfig
# Copyright (c) 2022 Duccio Breschi
# SPDX-License-Identifier: MIT

config SHIELD_OPENWORK_LEFT
    def_bool $(shields_list_contains,openwork_left)

config SHIELD_OPENWORK_RIGHT
    def_bool $(shields_list_contains,openwork_right)
```
